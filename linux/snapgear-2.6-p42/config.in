## linux/snapgear-2.6-p42/config.in
```kconfig
mainmenu_name 'SnapGear Embedded Linux Configuration'
mainmenu_option next_comment
comment 'Vendor/Product Selection'
comment 'Select the Vendor you wish to target'
choice 'Vendor' "gaisler CONFIG_DEFAULTS_GAISLER \
" gaisler
comment 'Select the Product you wish to target'
if [ "$CONFIG_DEFAULTS_GAISLER" = "y" ]; then
choice 'gaisler Products' "leon2mmu CONFIG_DEFAULTS_GAISLER_LEON2MMU \
leon3mmu CONFIG_DEFAULTS_GAISLER_LEON3MMU \
" leon3mmu
fi
comment 'Select the options for a selected Product'
#mainmenu_name 'Gaisler/Leon2mmu options'
#mainmenu_option next_comment
#comment 'Gaisler/Leon2mmu options'
#
#source vendors/gaisler/common/config.in
#
#endmenu

mainmenu_name 'Gaisler/Leon2/3 MMU options'
mainmenu_option next_comment
comment 'Gaisler/Leon2/3 MMU options'

source vendors/gaisler/common/config.in

endmenu
endmenu
mainmenu_option next_comment
comment 'Kernel/Library/Defaults Selection'
choice 'Kernel Version' "linux-2.6.21.1 CONFIG_DEFAULTS_KERNEL_2_6_21_1 \
linux-2.6.29 CONFIG_DEFAULTS_KERNEL_2_6_29 \
" linux-2.6.29
choice 'Libc Version' "glibc-from-compiler CONFIG_DEFAULTS_LIBC_GLIBC_FROM_COMPILER \
uclibc-from-compiler CONFIG_DEFAULTS_LIBC_UCLIBC_FROM_COMPILER \
none CONFIG_DEFAULTS_LIBC_NONE \
" glibc-from-compiler
bool 'Default all settings (lose changes)'	CONFIG_DEFAULTS_OVERRIDE
bool 'Customize Kernel Settings'			CONFIG_DEFAULTS_KERNEL
bool 'Customize Vendor/User Settings'		CONFIG_DEFAULTS_VENDOR
bool 'Update Default Vendor Settings'		CONFIG_DEFAULTS_VENDOR_UPDATE
endmenu



mainmenu_option next_comment
comment 'Template Configurations'
if [ "$CONFIG_DEFAULTS_GAISLER_LEON3MMU" = "y" ]; then
choice 'Templates for leon3mmu' " \
none CONFIG_TEMPLATE_LEON3MMU_NONE \
gr_l4itx_busybox CONFIG_TEMPLATE_LEON3MMU_GR_L4ITX_BUSYBOX \
gr_l4itx_serial CONFIG_TEMPLATE_LEON3MMU_GR_L4ITX_SERIAL \
gr_l4itx_video CONFIG_TEMPLATE_LEON3MMU_GR_L4ITX_VIDEO \
gr_xc3s_1500 CONFIG_TEMPLATE_LEON3MMU_GR_XC3S_1500 \
haps_51 CONFIG_TEMPLATE_LEON3MMU_HAPS_51 \
leon3_altera_ep2s60_ddr CONFIG_TEMPLATE_LEON3MMU_LEON3_ALTERA_EP2S60_DDR \
netfilter CONFIG_TEMPLATE_LEON3MMU_NETFILTER \
nfs_root CONFIG_TEMPLATE_LEON3MMU_NFS_ROOT \
vga_ps2 CONFIG_TEMPLATE_LEON3MMU_VGA_PS2 \
" none
fi
bool 'Update configurations with above selection'			CONFIG_TEMPLATES_UPDATE
endmenu
```

## linux/snapgear-2.6-p42/linux-2.6.21.1/drivers/ambapp/Kconfig
```kconfig
#------------------------------------------------------------------------------
# Amba device driver configuration
#------------------------------------------------------------------------------

menu "Grlib: Amba device driver configuration"

config AMBA_PROC
	bool "/proc filesystem for amba" 
	---help---
	Add /proc filesystem support to provide informations on 
	the amba bus and detected devices in /proc/bus/amba/

config AMBA_PNP_PRINT
	bool "Print AMBA PnP info"
	---help---
	Enabling this option will result in the AMBA Plug&Play information
	to be printed on the console on startup.

source "drivers/ambapp/gaisler/Kconfig"
source "drivers/ambapp/opencores/Kconfig"

endmenu
```

## linux/snapgear-2.6-p42/linux-2.6.21.1/drivers/ambapp/gaisler/Kconfig
```kconfig
menu "Vendor Gaisler"

config GRLIB_GAISLER_GPIO
	bool "Grlib gpio driver" 
	default y
	---help---
	  Add the driver for the grlib gpio core.

config GRLIB_GAISLER_APBUART
	bool "Grlib apbuart driver" 
	default y
	---help---
	  Add the driver for the grlib apbuart serial core.

config GRLIB_GAISLER_APBUART_CONSOLE
	bool "Grlib apbuart serial console"
	depends on GRLIB_GAISLER_APBUART
	select SERIAL_CORE_CONSOLE
	help
	  Running a console on grlib uart

	  
config GRLIB_GAISLER_GRETH
	tristate "Grlib's ethermac driver" 
	default y
	depends on NETDEVICES
        select CRC32
	---help---
	  Add the driver for the grlib ethermac.


config GRLIB_GAISLER_GRETH_MACMSB
	hex "MSB 24 bits of ethern number (hex)" 
	default 00007A
	depends on GRLIB_GAISLER_GRETH
	---help---
	  Most significant 24 bits of the default MAC address
	  that is initialized when driver probes. A good guess 
	  is 00007A.

config GRLIB_GAISLER_GRETH_MACLSB
	hex "LSB 24 bits of ethern number (hex)" 
	default CC0012
	depends on GRLIB_GAISLER_GRETH
	---help---
	  Least significant 24 bits of the default MAC address
	  that is initialized when driver probes. A good guess 
	  is CC0012.

	            
endmenu
```

## linux/snapgear-2.6-p42/linux-2.6.21.1/drivers/ambapp/opencores/Kconfig
```kconfig
menu "Vendor Opencores"

config GRLIB_OPENCORES_ETHERMAC
	tristate "Grlib's opencores ethermac driver" 
	default y
	depends on NETDEVICES
	---help---
	  Add the driver for the grlib opencore ethermac.


config GRLIB_OPENCORES_ETHERMAC_MACMSB
	hex "MSB 24 bits of ethern number (hex)" 
	default 00007A
	depends on GRLIB_OPENCORES_ETHERMAC
	---help---
	  Most significant 24 bits of the default MAC address
	  that is initialized when driver probes. A good guess 
	  is 00007A.

config GRLIB_OPENCORES_ETHERMAC_MACLSB
	hex "LSB 24 bits of ethern number (hex)" 
	default CC0012
	depends on GRLIB_OPENCORES_ETHERMAC
	---help---
	  Least significant 24 bits of the default MAC address
	  that is initialized when driver probes. A good guess 
	  is CC0012.
	  If there is more than one ethernet core, the less
	  significant bit is incremented.

config GRLIB_OPENCORES_ETHERMAC_FLUSH
	bool "Flush the BD pages before acessing them" 
	default y
	depends on GRLIB_OPENCORES_ETHERMAC
	---help---
	  Because opencores does physical address writes the virtual
	  address space of the processor has to be synced with a flush.
	  Set to no if you have disable caches or you are shure that
	  it can work otherwise. 	 


endmenu
```

## linux/snapgear-2.6-p42/linux-2.6.29/drivers/ambapp/Kconfig
```kconfig
#------------------------------------------------------------------------------
# Amba device driver configuration
#------------------------------------------------------------------------------

menu "Grlib: Amba device driver configuration"

config AMBA_PROC
	bool "/proc filesystem for amba" 
	---help---
	Add /proc filesystem support to provide informations on 
	the amba bus and detected devices in /proc/bus/amba/

source "drivers/ambapp/gaisler/Kconfig"

endmenu
```

## linux/snapgear-2.6-p42/vendors/gaisler/common/config.in
```kconfig
 bool 'Leon has mul/div (v8)' CONFIG_DEFAULTS_GAISLER_LEON2_MV8
 
 bool 'Leon has FPU' CONFIG_DEFAULTS_GAISLER_LEON2_FPU


choice 'CPU Freq khz' "\
20000 CONFIG_DEFAULTS_GAISLER_LEON2_FREQ_20000 \
25000 CONFIG_DEFAULTS_GAISLER_LEON2_FREQ_25000 \
30000 CONFIG_DEFAULTS_GAISLER_LEON2_FREQ_30000 \
40000 CONFIG_DEFAULTS_GAISLER_LEON2_FREQ_40000 \
50000 CONFIG_DEFAULTS_GAISLER_LEON2_FREQ_50000 \
80000 CONFIG_DEFAULTS_GAISLER_LEON2_FREQ_80000 \
100000 CONFIG_DEFAULTS_GAISLER_LEON2_FREQ_100000 \
101000 CONFIG_DEFAULTS_GAISLER_LEON2_FREQ_101000 \
" 40000

choice 'Baudrate' "9600 CONFIG_DEFAULTS_GAISLER_LEON2_BAUDRATE_9600 \
19200 CONFIG_DEFAULTS_GAISLER_LEON2_BAUDRATE_19200 \
38400 CONFIG_DEFAULTS_GAISLER_LEON2_BAUDRATE_38400 \
" 38400

 bool 'start with uart loopback on' CONFIG_DEFAULTS_GAISLER_LEON2_LOOPBACK

 bool 'start with uart hardware flowctrl' CONFIG_DEFAULTS_GAISLER_LEON2_UARTFLOWCTRL
 
choice 'Initial root filesystem' "\
 romfs CONFIG_KERNEL_ROOTMEM_ROMFS \
 initramfs CONFIG_KERNEL_ROOTMEM_INITRAMFS \
 none CONFIG_KERNEL_ROOTMEM_NONE \
 " initramfs

if [ "$CONFIG_KERNEL_ROOTMEM_INITRAMFS" = "y" ]; then
  string 'Custom initramfs source file' CONFIG_KERNEL_INITRAMFS_SOURCE ""
  bool 'Do not build Snapgear initramfs' CONFIG_KERNEL_INITRAMFS_SOURCE_EXCLUSIVE
fi

string 'Init pathname' CONFIG_KERNEL_INIT_PATH "/sbin/init"
  
 string 'Kernel command line' CONFIG_KERNEL_COMMAND_LINE "console=ttyS0,38400"

  choice 'Rom bank size' "\
  8k CONFIG_DEFAULTS_GAISLER_LEON2_ROMSIZE_8k \
  16k CONFIG_DEFAULTS_GAISLER_LEON2_ROMSIZE_16k \
  32k CONFIG_DEFAULTS_GAISLER_LEON2_ROMSIZE_32k \
  64k CONFIG_DEFAULTS_GAISLER_LEON2_ROMSIZE_64k \
  128k CONFIG_DEFAULTS_GAISLER_LEON2_ROMSIZE_128k \
  256k CONFIG_DEFAULTS_GAISLER_LEON2_ROMSIZE_256k \
  512k CONFIG_DEFAULTS_GAISLER_LEON2_ROMSIZE_512k \
  1mb CONFIG_DEFAULTS_GAISLER_LEON2_ROMSIZE_1mb \
  2mb CONFIG_DEFAULTS_GAISLER_LEON2_ROMSIZE_2mb \
  4mb CONFIG_DEFAULTS_GAISLER_LEON2_ROMSIZE_4mb \
  8mb CONFIG_DEFAULTS_GAISLER_LEON2_ROMSIZE_8mb \
  16mb CONFIG_DEFAULTS_GAISLER_LEON2_ROMSIZE_16mb \
  32mb CONFIG_DEFAULTS_GAISLER_LEON2_ROMSIZE_32mb \
  64mb CONFIG_DEFAULTS_GAISLER_LEON2_ROMSIZE_64mb \
  128mb CONFIG_DEFAULTS_GAISLER_LEON2_ROMSIZE_128mb \
  256mb CONFIG_DEFAULTS_GAISLER_LEON2_ROMSIZE_256mb \
  " 8mb

  choice 'Rom rws' "\
  0 CONFIG_DEFAULTS_GAISLER_LEON2_ROM_rws_0 \
  1 CONFIG_DEFAULTS_GAISLER_LEON2_ROM_rws_1 \
  2 CONFIG_DEFAULTS_GAISLER_LEON2_ROM_rws_2 \
  3 CONFIG_DEFAULTS_GAISLER_LEON2_ROM_rws_3 \
  4 CONFIG_DEFAULTS_GAISLER_LEON2_ROM_rws_4 \
  5 CONFIG_DEFAULTS_GAISLER_LEON2_ROM_rws_5 \
  6 CONFIG_DEFAULTS_GAISLER_LEON2_ROM_rws_6 \
  7 CONFIG_DEFAULTS_GAISLER_LEON2_ROM_rws_7 \
  8 CONFIG_DEFAULTS_GAISLER_LEON2_ROM_rws_8 \
  9 CONFIG_DEFAULTS_GAISLER_LEON2_ROM_rws_9 \
  10 CONFIG_DEFAULTS_GAISLER_LEON2_ROM_rws_10 \
  11 CONFIG_DEFAULTS_GAISLER_LEON2_ROM_rws_11 \
  12 CONFIG_DEFAULTS_GAISLER_LEON2_ROM_rws_12 \
  13 CONFIG_DEFAULTS_GAISLER_LEON2_ROM_rws_13 \
  14 CONFIG_DEFAULTS_GAISLER_LEON2_ROM_rws_14 \
  15 CONFIG_DEFAULTS_GAISLER_LEON2_ROM_rws_15 \
  " 2

  choice 'Rom wws' "\
  0 CONFIG_DEFAULTS_GAISLER_LEON2_ROM_wws_0 \
  1 CONFIG_DEFAULTS_GAISLER_LEON2_ROM_wws_1 \
  2 CONFIG_DEFAULTS_GAISLER_LEON2_ROM_wws_2 \
  3 CONFIG_DEFAULTS_GAISLER_LEON2_ROM_wws_3 \
  4 CONFIG_DEFAULTS_GAISLER_LEON2_ROM_wws_4 \
  5 CONFIG_DEFAULTS_GAISLER_LEON2_ROM_wws_5 \
  6 CONFIG_DEFAULTS_GAISLER_LEON2_ROM_wws_6 \
  7 CONFIG_DEFAULTS_GAISLER_LEON2_ROM_wws_7 \
  8 CONFIG_DEFAULTS_GAISLER_LEON2_ROM_wws_8 \
  9 CONFIG_DEFAULTS_GAISLER_LEON2_ROM_wws_9 \
  10 CONFIG_DEFAULTS_GAISLER_LEON2_ROM_wws_10 \
  11 CONFIG_DEFAULTS_GAISLER_LEON2_ROM_wws_11 \
  12 CONFIG_DEFAULTS_GAISLER_LEON2_ROM_wws_12 \
  13 CONFIG_DEFAULTS_GAISLER_LEON2_ROM_wws_13 \
  14 CONFIG_DEFAULTS_GAISLER_LEON2_ROM_wws_14 \
  15 CONFIG_DEFAULTS_GAISLER_LEON2_ROM_wws_15 \
  " 2
	
  bool 'Enable writecycles to PROM' CONFIG_DEFAULTS_GAISLER_LEON2_ROM_WE

  choice 'Ram type' "\
  sram CONFIG_DEFAULTS_GAISLER_LEON2_USE_SRAM \
  sdram CONFIG_DEFAULTS_GAISLER_LEON2_USE_SDRAM \
  ddrsdram CONFIG_DEFAULTS_GAISLER_LEON2_USE_DDRSDRAM \
  ddr2sdram CONFIG_DEFAULTS_GAISLER_LEON2_USE_DDR2SDRAM \
  " sdram

if [ "$CONFIG_DEFAULTS_GAISLER_LEON2_USE_SRAM" = "y" ]; then

  comment 'SRam options'
  choice 'SRam bank size' "\
  8k CONFIG_DEFAULTS_GAISLER_LEON2_SRAMSIZE_8k \
  16k CONFIG_DEFAULTS_GAISLER_LEON2_SRAMSIZE_16k \
  32k CONFIG_DEFAULTS_GAISLER_LEON2_SRAMSIZE_32k \
  64k CONFIG_DEFAULTS_GAISLER_LEON2_SRAMSIZE_64k \
  128k CONFIG_DEFAULTS_GAISLER_LEON2_SRAMSIZE_128k \
  256k CONFIG_DEFAULTS_GAISLER_LEON2_SRAMSIZE_256k \
  512k CONFIG_DEFAULTS_GAISLER_LEON2_SRAMSIZE_512k \
  1mb CONFIG_DEFAULTS_GAISLER_LEON2_SRAMSIZE_1mb \
  2mb CONFIG_DEFAULTS_GAISLER_LEON2_SRAMSIZE_2mb \
  4mb CONFIG_DEFAULTS_GAISLER_LEON2_SRAMSIZE_4mb \
  8mb CONFIG_DEFAULTS_GAISLER_LEON2_SRAMSIZE_8mb \
  16mb CONFIG_DEFAULTS_GAISLER_LEON2_SRAMSIZE_16mb \
  32mb CONFIG_DEFAULTS_GAISLER_LEON2_SRAMSIZE_32mb \
  64mb CONFIG_DEFAULTS_GAISLER_LEON2_SRAMSIZE_64mb \
  128mb CONFIG_DEFAULTS_GAISLER_LEON2_SRAMSIZE_128mb \
  256mb CONFIG_DEFAULTS_GAISLER_LEON2_SRAMSIZE_256mb \
  " 4mb

  choice 'SRam banks' "\
  1 CONFIG_DEFAULTS_GAISLER_LEON2_SRAMBANKS_1 \
  2 CONFIG_DEFAULTS_GAISLER_LEON2_SRAMBANKS_2 \
  3 CONFIG_DEFAULTS_GAISLER_LEON2_SRAMBANKS_3 \
  4 CONFIG_DEFAULTS_GAISLER_LEON2_SRAMBANKS_4 \
  " 1

  choice 'SRam rws' "\
  0 CONFIG_DEFAULTS_GAISLER_LEON2_SRAM_rws_0 \
  1 CONFIG_DEFAULTS_GAISLER_LEON2_SRAM_rws_1 \
  2 CONFIG_DEFAULTS_GAISLER_LEON2_SRAM_rws_2 \
  3 CONFIG_DEFAULTS_GAISLER_LEON2_SRAM_rws_3 \
  " 0

  choice 'SRam wws' "\
  0 CONFIG_DEFAULTS_GAISLER_LEON2_SRAM_wws_0 \
  1 CONFIG_DEFAULTS_GAISLER_LEON2_SRAM_wws_1 \
  2 CONFIG_DEFAULTS_GAISLER_LEON2_SRAM_wws_2 \
  3 CONFIG_DEFAULTS_GAISLER_LEON2_SRAM_wws_3 \
  " 0

  choice 'SRam rms' "\
  0 CONFIG_DEFAULTS_GAISLER_LEON2_SRAM_rms_0 \
  1 CONFIG_DEFAULTS_GAISLER_LEON2_SRAM_rms_1 \
  2 CONFIG_DEFAULTS_GAISLER_LEON2_SRAM_rms_2 \
  3 CONFIG_DEFAULTS_GAISLER_LEON2_SRAM_rms_3 \
  " 0

fi


if [ "$CONFIG_DEFAULTS_GAISLER_LEON2_USE_SDRAM" = "y" -o "$CONFIG_DEFAULTS_GAISLER_LEON2_USE_DDRSDRAM" = "y" -o "$CONFIG_DEFAULTS_GAISLER_LEON2_USE_DDR2SDRAM" = "y" ]; then

  comment 'SDRam options'
  choice 'SDRam bank size' "\
  4mb CONFIG_DEFAULTS_GAISLER_LEON2_SDRAMSIZE_4mb \
  8mb CONFIG_DEFAULTS_GAISLER_LEON2_SDRAMSIZE_8mb \
  16mb CONFIG_DEFAULTS_GAISLER_LEON2_SDRAMSIZE_16mb \
  32mb CONFIG_DEFAULTS_GAISLER_LEON2_SDRAMSIZE_32mb \
  64mb CONFIG_DEFAULTS_GAISLER_LEON2_SDRAMSIZE_64mb \
  128mb CONFIG_DEFAULTS_GAISLER_LEON2_SDRAMSIZE_128mb \
  256mb CONFIG_DEFAULTS_GAISLER_LEON2_SDRAMSIZE_256mb \
  512mb CONFIG_DEFAULTS_GAISLER_LEON2_SDRAMSIZE_512mb \
  1024mb CONFIG_DEFAULTS_GAISLER_LEON2_SDRAMSIZE_1024mb \
  " 16mb

  choice 'SDRam banks' "\
  1 CONFIG_DEFAULTS_GAISLER_LEON2_SDRAMBANKS_1 \
  2 CONFIG_DEFAULTS_GAISLER_LEON2_SDRAMBANKS_2 \
	3 CONFIG_DEFAULTS_GAISLER_LEON2_SDRAMBANKS_3 \
  4 CONFIG_DEFAULTS_GAISLER_LEON2_SDRAMBANKS_4 \
  " 1
  
  choice 'SDRam column size' "\
  256 CONFIG_DEFAULTS_GAISLER_LEON2_SDRAMCOL_256 \
  512 CONFIG_DEFAULTS_GAISLER_LEON2_SDRAMCOL_512 \
  1024 CONFIG_DEFAULTS_GAISLER_LEON2_SDRAMCOL_1024 \
  2048 CONFIG_DEFAULTS_GAISLER_LEON2_SDRAMCOL_2048 \
  4096 CONFIG_DEFAULTS_GAISLER_LEON2_SDRAMCOL_4096 \
  " 256

  string 'SDRam refresh' CONFIG_DEFAULTS_GAISLER_LEON2_SDRAM_refresh "7.8"
fi

if [ "$CONFIG_DEFAULTS_GAISLER_LEON2_USE_SDRAM" = "y" ]; then
  choice 'SDRam cas delay' "\
  2 CONFIG_DEFAULTS_GAISLER_LEON2_SDRAMCAS_2 \
  3 CONFIG_DEFAULTS_GAISLER_LEON2_SDRAMCAS_3 \
  " 2
  int 'SDRam trfc' CONFIG_DEFAULTS_GAISLER_LEON2_SDRAM_trfc 66
  int 'SDRam trp' CONFIG_DEFAULTS_GAISLER_LEON2_SDRAM_trp 20
fi

if [ "$CONFIG_DEFAULTS_GAISLER_LEON2_USE_DDR2SDRAM" = "y" -o "$CONFIG_DEFAULTS_GAISLER_LEON2_USE_DDRSDRAM" = "y" ]; then
  int 'DDR SDRAM Frequency [MHz]' CONFIG_DEFAULTS_GAISLER_LEON2_DDR2SDRAM_FREQ 200
fi

if [ "$CONFIG_DEFAULTS_GAISLER_LEON2_USE_SDRAM" = "y" -o "$CONFIG_DEFAULTS_GAISLER_LEON2_USE_DDRSDRAM" = "y" -o "$CONFIG_DEFAULTS_GAISLER_LEON2_USE_DDR2SDRAM" = "y" ]; then
  bool 'Keep sram (no nosram bit set, flashbz only)' CONFIG_DEFAULTS_GAISLER_LEON2_SDRAM_SRAMKEEP
fi

 comment 'Kernel image position'
 bool 'ALternative phy. kernel address' CONFIG_KERNEL_PHYSICAL_ADDR_SET
 if [ "$CONFIG_KERNEL_PHYSICAL_ADDR_SET" = "y" ]; then
   string 'Physical Kernel image address' CONFIG_KERNEL_PHYSICAL_ADDR "0x40000000"
   string 'Stackbase' CONFIG_KERNEL_PHYSICAL_STACK "0x40200000"
   comment 'Available memory is calculated by:'
   comment 'Stackbase-Physical_Kernel_image_address'
 fi




 
```

## linux/snapgear-2.6-p42/vendors/gaisler/leon3mmu/config.in
```kconfig
mainmenu_name 'Gaisler/Leon2/3 MMU options'
mainmenu_option next_comment
comment 'Gaisler/Leon2/3 MMU options'

source vendors/gaisler/common/config.in

endmenu
```
